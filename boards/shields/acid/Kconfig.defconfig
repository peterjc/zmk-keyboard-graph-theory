## boards/shields/acid/Kconfig.defconfig
```kconfig
if SHIELD_ACID_LEFT

config ZMK_KEYBOARD_NAME
    default "Acid"

config ZMK_SPLIT_ROLE_CENTRAL
    default y

config ZMK_STUDIO
    default y

endif

if SHIELD_ACID_LEFT || SHIELD_ACID_RIGHT

config ZMK_SPLIT
    default y

endif
```

## boards/shields/acid/Kconfig.shield
```kconfig
# Copyright (c) 2025 Peter J. A. Cock
# SPDX-License-Identifier: MIT

config SHIELD_ACID_LEFT
    def_bool $(shields_list_contains,acid_left)
config SHIELD_ACID_RIGHT
    def_bool $(shields_list_contains,acid_right)
```

## boards/shields/bivouac34/Kconfig.defconfig
```kconfig
# Copyright (c) 2020 The ZMK Contributors
# SPDX-License-Identifier: MIT

if SHIELD_BIVOUAC34

config ZMK_KEYBOARD_NAME
    default "Bivouac34"

endif
```

## boards/shields/bivouac34/Kconfig.shield
```kconfig
# Copyright (c) 2025 Peter J. A. Cock
# SPDX-License-Identifier: MIT

config SHIELD_BIVOUAC34
    def_bool $(shields_list_contains,bivouac34)
```

## boards/shields/bivvy16d/Kconfig.defconfig
```kconfig
# Copyright (c) 2020 The ZMK Contributors
# SPDX-License-Identifier: MIT

if SHIELD_BIVVY16D_LEFT

config ZMK_KEYBOARD_NAME
    default "Bivvy16D"

config ZMK_SPLIT_ROLE_CENTRAL
    default y

config ZMK_STUDIO
    default y

endif

if SHIELD_BIVVY16D_LEFT || SHIELD_BIVVY16D_RIGHT

config ZMK_SPLIT
    default y

endif
```

## boards/shields/bivvy16d/Kconfig.shield
```kconfig
# Copyright (c) 2025 Peter J. A. Cock
# SPDX-License-Identifier: MIT

config SHIELD_BIVVY16D_LEFT
    def_bool $(shields_list_contains,bivvy16d_left)
config SHIELD_BIVVY16D_RIGHT
    def_bool $(shields_list_contains,bivvy16d_right)
```

## boards/shields/fly_half/Kconfig.defconfig
```kconfig
if SHIELD_FLY_HALF_LEFT

config ZMK_KEYBOARD_NAME
    default "Fly Half"

config ZMK_SPLIT_ROLE_CENTRAL
    default y

config ZMK_STUDIO
    default y

endif

if SHIELD_FLY_HALF_LEFT || SHIELD_FLY_HAFL_RIGHT

config ZMK_SPLIT
    default y

endif
```

## boards/shields/fly_half/Kconfig.shield
```kconfig
# Copyright (c) 2026 Peter J. A. Cock
# SPDX-License-Identifier: MIT

config SHIELD_FLY_HALF_LEFT
    def_bool $(shields_list_contains,fly_half_left)
config SHIELD_FLY_HALF_RIGHT
    def_bool $(shields_list_contains,fly_half_right)
```

## boards/shields/goldilocks32/Kconfig.shield
```kconfig
# Copyright (c) 2025 Peter J. A. Cock
# SPDX-License-Identifier: MIT

config SHIELD_GOLDILOCKS32
    def_bool $(shields_list_contains,goldilocks32)
```

## boards/shields/hesse/Kconfig.defconfig
```kconfig
# Copyright (c) 2020 The ZMK Contributors
# SPDX-License-Identifier: MIT

if SHIELD_HESSE

config ZMK_KEYBOARD_NAME
    default "Hesse"

endif
```

## boards/shields/rugby_league/Kconfig.defconfig
```kconfig
if SHIELD_RUGBY_LEAGUE_LEFT

config ZMK_KEYBOARD_NAME
    default "Rugby League"

config ZMK_SPLIT_ROLE_CENTRAL
    default y

config ZMK_STUDIO
    default y

endif

if SHIELD_RUGBY_LEAGUE_LEFT || SHIELD_RUGBY_LEAGUE_RIGHT

config ZMK_SPLIT
    default y

endif
```

## boards/shields/rugby_league/Kconfig.shield
```kconfig
# Copyright (c) 2026 Peter J. A. Cock
# SPDX-License-Identifier: MIT

config SHIELD_RUGBY_LEAGUE_LEFT
    def_bool $(shields_list_contains,rugby_league_left)
config SHIELD_RUGBY_LEAGUE_RIGHT
    def_bool $(shields_list_contains,rugby_league_right)
```

## boards/shields/rugby_union/Kconfig.defconfig
```kconfig
# Copyright (c) 2020 The ZMK Contributors
# SPDX-License-Identifier: MIT

if SHIELD_RUGBY_UNION

config ZMK_KEYBOARD_NAME
    default "Rugby Union"

endif
```

## boards/shields/rugby_union/Kconfig.shield
```kconfig
# Copyright (c) 2025 Peter J. A. Cock
# SPDX-License-Identifier: MIT

config SHIELD_RUGBY_UNION
    def_bool $(shields_list_contains,rugby_union)
```

## boards/shields/slump34t/Kconfig.defconfig
```kconfig
# Copyright (c) 2020 The ZMK Contributors
# SPDX-License-Identifier: MIT

if SHIELD_SLUMP34T

config ZMK_KEYBOARD_NAME
    default "Slump34t"

endif
```

## boards/shields/slump34t/Kconfig.shield
```kconfig
# Copyright (c) 2025 Peter J. A. Cock
# SPDX-License-Identifier: MIT

config SHIELD_SLUMP34T
    def_bool $(shields_list_contains,slump34t)
```

## boards/shields/slump52/Kconfig.defconfig
```kconfig
# Copyright (c) 2020 The ZMK Contributors
# SPDX-License-Identifier: MIT

if SHIELD_SLUMP52

config ZMK_KEYBOARD_NAME
    default "Slump52"

endif
```

## boards/shields/slump52/Kconfig.shield
```kconfig
# Copyright (c) 2025 Peter J. A. Cock
# SPDX-License-Identifier: MIT

config SHIELD_SLUMP52
    def_bool $(shields_list_contains,slump52)
```

## boards/shields/tester_esp32s3_devkitc/Kconfig.defconfig
```kconfig
if SHIELD_TESTER_ESP32S3_DEVKITC

config ZMK_KEYBOARD_NAME
    default "ZMK Tester"

config ZMK_BLE
    def_bool n

config SETTINGS
    def_bool n

endif
```

## boards/shields/tester_esp32s3_devkitc/Kconfig.shield
```kconfig
config SHIELD_TESTER_ESP32S3_DEVKITC
    def_bool $(shields_list_contains,tester_esp32s3_devkitc)
```

## config/west.yml
```yaml
manifest:
  defaults:
    # This is currently ZMK pre-0.4, using Zephyr 4.1
    revision: main
  remotes:
    - name: zmkfirmware
      url-base: https://github.com/zmkfirmware
    # Additional modules containing boards/shields/custom code can be listed here as well
    # See https://docs.zephyrproject.org/3.2.0/develop/west/manifest.html#projects
    - name: petejohanson
      url-base: https://github.com/petejohanson
  projects:
    - name: zmk
      remote: petejohanson
      revision: 5565f2179c1af83bdf210a6a362dfa4193c56189
      import: app/west.yml
  self:
    path: config
```

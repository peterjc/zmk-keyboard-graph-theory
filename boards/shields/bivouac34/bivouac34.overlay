/*
 * Copyright (c) 2020 The ZMK Contributors
 *
 * SPDX-License-Identifier: MIT
 */

#include <dt-bindings/zmk/matrix_transform.h>
#include <physical_layouts.dtsi>
#include "bivouac34-layouts.dtsi"

/ {
    kscan0: kscan0 {
        compatible = "zmk,kscan-gpio-matrix";
        diode-direction = "col2row";
        wakeup-source;

        /* Can't use &pico_header 29 as not defined */
        col-gpios
            = <&gpio0 2 (GPIO_ACTIVE_LOW | GPIO_PULL_UP)>
            , <&gpio0 9 (GPIO_ACTIVE_LOW | GPIO_PULL_UP)>
            , <&gpio0 13 (GPIO_ACTIVE_LOW | GPIO_PULL_UP)>
            , <&gpio0 26 (GPIO_ACTIVE_LOW | GPIO_PULL_UP)>
            , <&gpio0 28 (GPIO_ACTIVE_LOW | GPIO_PULL_UP)>
            , <&gpio0 29 (GPIO_ACTIVE_LOW | GPIO_PULL_UP)>
            , <&gpio0 27 (GPIO_ACTIVE_LOW | GPIO_PULL_UP)>
            , <&gpio0 12 (GPIO_ACTIVE_LOW | GPIO_PULL_UP)>
            , <&gpio0 8 (GPIO_ACTIVE_LOW | GPIO_PULL_UP)>
            , <&gpio0 1 (GPIO_ACTIVE_LOW | GPIO_PULL_UP)>
            ;

        row-gpios
            = <&gpio0 10 GPIO_OPEN_DRAIN>
            , <&gpio0 14 GPIO_OPEN_DRAIN>
            , <&gpio0 0 GPIO_OPEN_DRAIN>
            , <&gpio0 4 GPIO_OPEN_DRAIN>
            , <&gpio0 11 GPIO_OPEN_DRAIN>
            , <&gpio0 15 GPIO_OPEN_DRAIN>
            , <&gpio0 5 GPIO_OPEN_DRAIN>
            , <&gpio0 3 GPIO_OPEN_DRAIN>
            , <&gpio0 7 GPIO_OPEN_DRAIN>
            , <&gpio0 6 GPIO_OPEN_DRAIN>
            ;
    };
};

/ {
    chosen {
        zmk,physical-layout = &physical_layout34;
        // Other chosen items
    };
};

/* The GPIO pins are the same, just layout mirrored */

#include <dt-bindings/zmk/matrix_transform.h>
#include <physical_layouts.dtsi>
#include "bivvy16d-layouts.dtsi"

&bivvy16d_L16_R16_transform {
    col-offset = <8>;
};

&bivvy16d_L15_R16_transform {
    col-offset = <8>;
};

&bivvy16d_L16_R15_transform {
    col-offset = <8>;
};

&bivvy16d_L15_R15_transform {
    col-offset = <8>;
};


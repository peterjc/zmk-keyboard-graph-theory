## boards/shields/curved_conversion/Kconfig.defconfig
```kconfig
# Copyright (c) 2020 The ZMK Contributors
# SPDX-License-Identifier: MIT

if SHIELD_CURVED_CONVERSION

config ZMK_KEYBOARD_NAME
    default "Curved Conversion"

endif
```

## boards/shields/curved_conversion/Kconfig.shield
```kconfig
# Copyright (c) 2026 Peter J. A. Cock
# SPDX-License-Identifier: MIT

config SHIELD_CURVED_CONVERSION
    def_bool $(shields_list_contains,curved_conversion)
```

## boards/shields/warped30/Kconfig.defconfig
```kconfig
# Copyright (c) 2020 The ZMK Contributors
# SPDX-License-Identifier: MIT

if SHIELD_WARPED30

config ZMK_KEYBOARD_NAME
    default "Wee Bit Warped"

endif
```

## boards/shields/warped30/Kconfig.shield
```kconfig
# Copyright (c) 2026 Peter J. A. Cock
# SPDX-License-Identifier: MIT

config SHIELD_WARPED30
    def_bool $(shields_list_contains,warped30)
```

#include <dt-bindings/zmk/matrix_transform.h>
#include <physical_layouts.dtsi>
#include "fly_half-layouts.dtsi"

&matrix_transform30 {
    row-offset = <1>;
};

/* The GPIO pins are the same left and right, but in different order */
/ {
    matrix: matrix {
        compatible = "zmk,input-gpio-direct";
        wakeup-source;
        input-gpios
            /* Right hand top row, pinky to inner column */
            = <&gpio0 14 (GPIO_ACTIVE_LOW | GPIO_PULL_UP)>
            , <&gpio0 13 (GPIO_ACTIVE_LOW | GPIO_PULL_UP)>
            , <&gpio1 8 (GPIO_ACTIVE_LOW | GPIO_PULL_UP)>
            , <&gpio1 0 (GPIO_ACTIVE_LOW | GPIO_PULL_UP)>
            , <&gpio1 3 (GPIO_ACTIVE_LOW | GPIO_PULL_UP)>
            /* Right hand home row, pinky to inner column */
            , <&gpio0 12 (GPIO_ACTIVE_LOW | GPIO_PULL_UP)>
            , <&gpio0 10 (GPIO_ACTIVE_LOW | GPIO_PULL_UP)>
            , <&gpio1 5 (GPIO_ACTIVE_LOW | GPIO_PULL_UP)>
            , <&gpio1 23 (GPIO_ACTIVE_LOW | GPIO_PULL_UP)>
            , <&gpio1 24 (GPIO_ACTIVE_LOW | GPIO_PULL_UP)>
            /* Rights hand bottom row, pinky to thumb (in place of inner column) */
            , <&gpio0 11 (GPIO_ACTIVE_LOW | GPIO_PULL_UP)>
            , <&gpio0 9 (GPIO_ACTIVE_LOW | GPIO_PULL_UP)>
            , <&gpio1 4 (GPIO_ACTIVE_LOW | GPIO_PULL_UP)>
            , <&gpio1 2 (GPIO_ACTIVE_LOW | GPIO_PULL_UP)>
            , <&gpio1 1 (GPIO_ACTIVE_LOW | GPIO_PULL_UP)>
            ;
    };
};
